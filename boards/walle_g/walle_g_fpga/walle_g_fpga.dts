/*
 * Copyright (c) 2024
 *
 * SPDX-License-Identifier: Apache-2.0
 */

/dts-v1/;

#include <efinix/walle_g_soc.dtsi>

/ {
	model = "walle_g FPGA Board";
	compatible = "efinix,walle-g-fpga";

	chosen {
		zephyr,sram = &ram0;
		zephyr,flash = &flash0;
	};
};
