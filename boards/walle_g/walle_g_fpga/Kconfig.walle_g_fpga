## boards/walle_g/walle_g_fpga/Kconfig.walle_g_fpga
```kconfig
# Copyright (c) 2024
# SPDX-License-Identifier: Apache-2.0

config BOARD_WALLE_G_FPGA
	select SOC_WALLE_G
```

## boards/walle_g/walle_g_fpga/board.yml
```yaml
board:
  name: walle_g_fpga
  full_name: walle_g FPGA Board
  vendor: efinix
  socs:
  - name: walle_g
```

## boards/walle_g/walle_g_fpga/walle_g_fpga_defconfig
```kconfig
# Copyright (c) 2024
# SPDX-License-Identifier: Apache-2.0

# Console and serial
CONFIG_CONSOLE=n
CONFIG_SERIAL=n
CONFIG_UART_CONSOLE=n

# No clock control (fixed 100MHz)
CONFIG_CLOCK_CONTROL=n

# Code in ram_code, data/bss/heap in ram_main
CONFIG_XIP=y

# Heap configuration for 64KB ram_main
CONFIG_HEAP_MEM_POOL_SIZE=8192

# Stack configuration
CONFIG_MAIN_STACK_SIZE=2048
CONFIG_INIT_STACKS=n

# Runtime basics
CONFIG_MULTITHREADING=y
CONFIG_PRINTK=n
CONFIG_EARLY_CONSOLE=n
CONFIG_BOOT_BANNER=n
CONFIG_RISCV_MACHINE_TIMER=n
CONFIG_SYS_CLOCK_EXISTS=n

# No FPU
CONFIG_FPU=n
CONFIG_FP_HARDABI=n
CONFIG_FP_SOFTABI=n
```

## drivers/i2c/Kconfig.efinix
```kconfig
# Copyright (c) 2026
# SPDX-License-Identifier: Apache-2.0

config I2C_EFINIX_SAPPHIRE
	bool "Efinix Sapphire I2C controller"
	default y
	depends on DT_HAS_EFINIX_SAPPHIRE_I2C_ENABLED
	help
	  Enable the Efinix Sapphire I2C controller driver.
```

## drivers/spi/Kconfig.efinix
```kconfig
# Copyright (c) 2026
# SPDX-License-Identifier: Apache-2.0

config SPI_EFINIX_SAPPHIRE
	bool "Efinix Sapphire SPI controller"
	default y
	depends on DT_HAS_EFINIX_SAPPHIRE_SPI_ENABLED
	help
	  Enable the Efinix Sapphire SPI controller driver.
```

## dts/bindings/i2c/efinix,sapphire-i2c.yaml
```yaml
# Copyright (c) 2026
# SPDX-License-Identifier: Apache-2.0

description: Efinix Sapphire I2C controller

compatible: "efinix,sapphire-i2c"

include: [i2c-controller.yaml, pinctrl-device.yaml]

properties:
  reg:
    required: true
```

## dts/bindings/spi/efinix,sapphire-spi.yaml
```yaml
# Copyright (c) 2026
# SPDX-License-Identifier: Apache-2.0

description: Efinix Sapphire SPI controller

compatible: "efinix,sapphire-spi"

include: [spi-controller.yaml, pinctrl-device.yaml]

properties:
  reg:
    required: true
```

## soc/walle_g/Kconfig
```kconfig
# Copyright (c) 2024
# SPDX-License-Identifier: Apache-2.0

config SOC_WALLE_G
	select INCLUDE_RESET_VECTOR
	select RISCV_ISA_RV32I
	select RISCV_ISA_EXT_M
	select RISCV_ISA_EXT_C
	# No A extension (matches soc.h)
	select RISCV_ISA_EXT_ZICSR
	select RISCV_ISA_EXT_ZIFENCEI
	select RISCV
	select RISCV_PRIVILEGED
	imply XIP
```

## soc/walle_g/Kconfig.defconfig
```kconfig
# Copyright (c) 2024
# SPDX-License-Identifier: Apache-2.0

if SOC_WALLE_G

config SYS_CLOCK_HW_CYCLES_PER_SEC
	default 100000000

config RISCV_SOC_INTERRUPT_INIT
	default y

config NUM_IRQS
	default 36

config 2ND_LVL_INTR_00_OFFSET
	default 11

# No A extension
config ATOMIC_OPERATIONS_C
	default y

# Keep code in ram_code and data/bss in ram_main.
config XIP
	default y

# Stack and heap settings for ram_main (64KB)
config MAIN_STACK_SIZE
	default 2048

config HEAP_MEM_POOL_SIZE
	default 8192

endif # SOC_WALLE_G
```

## soc/walle_g/Kconfig.soc
```kconfig
# Copyright (c) 2024
# SPDX-License-Identifier: Apache-2.0

config SOC_WALLE_G
	bool
	help
	  walle_g - Custom FPGA SoC with split ram_code/ram_main layout
	  Features:
	  - Code region at 0x10000000, data SRAM at 0x10070000
	  - RV32IMC ISA (no A/F/D extensions)
	  - Efinix Sapphire-compatible interrupt and UART blocks

config SOC
	default "walle_g" if SOC_WALLE_G
```
